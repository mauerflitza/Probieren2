VERSION ""

NS_ :

BS_:

BU_: Reciever Motor Acc_node

BO_ 37 engine: 2 Motor
 SG_ e_gyro : 8|8@1- (1,0) [0|0] ""  Reciever
 SG_ e_temp : 0|8@1- (1,3) [2|4] "temp"  Reciever

BO_ 3 acc: 5 Acc_node
 SG_ acc_y : 8|8@1- (1,0) [0|0] ""  Reciever
 SG_ acc_x : 0|8@1- (1,0) [0|0] ""  Reciever

BA_DEF_  "BusType" STRING ;
BA_DEF_DEF_  "BusType" "CAN";
